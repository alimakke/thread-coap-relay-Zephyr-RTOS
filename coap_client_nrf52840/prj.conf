## CMakeLists.txt
```
#
# Copyright (c) 2020 Nordic Semiconductor ASA
#
# SPDX-License-Identifier: LicenseRef-Nordic-5-Clause
#
cmake_minimum_required(VERSION 3.20.0)

find_package(Zephyr REQUIRED HINTS $ENV{ZEPHYR_BASE})

project(coap_client)

# NORDIC SDK APP START
target_sources(app PRIVATE src/coap_client.c src/coap_client_utils.c)

target_include_directories(app PUBLIC coap_server/interface)
# NORDIC SDK APP END

target_sources_ifdef(CONFIG_BT_NUS app PRIVATE src/ble_utils.c)
```

## prj.conf
```kconfig
#
# Copyright (c) 2020 Nordic Semiconductor
#
# SPDX-License-Identifier: LicenseRef-Nordic-5-Clause
#

# nRF board library
CONFIG_DK_LIBRARY=y

# Enable CoAP utils and CoAP protocol
CONFIG_COAP=y
CONFIG_COAP_UTILS=y

# Generic networking options
CONFIG_NETWORKING=y

# L2 OpenThread enabling
CONFIG_NET_L2_OPENTHREAD=y

# Network shell
CONFIG_SHELL=y
CONFIG_OPENTHREAD_SHELL=y
CONFIG_SHELL_ARGC_MAX=26
CONFIG_SHELL_CMD_BUFF_SIZE=416

# Network sockets
CONFIG_NET_SOCKETS=y
CONFIG_ZVFS_POLL_MAX=4

# Same network Master Key for client and server
CONFIG_OPENTHREAD_NETWORKKEY="00:11:22:33:44:55:66:77:88:99:aa:bb:cc:dd:ee:ff"

CONFIG_FPU=y

# Increase main stack size to meet networking requirements
CONFIG_MAIN_STACK_SIZE=4096

# Set product string for USB device
CONFIG_CDC_ACM_SERIAL_PRODUCT_STRING="OpenThread CoAP Client"
CONFIG_USE_DT_CODE_PARTITION=y
CONFIG_BUILD_OUTPUT_UF2=y
CONFIG_UART_CONSOLE=y
CONFIG_LOG=y
CONFIG_LOG_DEFAULT_LEVEL=3
CONFIG_OPENTHREAD_COAP=y
CONFIG_VOLTAGE_DIVIDER=n
CONFIG_UDC_BUF_POOL_SIZE=8192
```

## src/coap_client.c
```c
/*
 * Copyright (c) 2020 Nordic Semiconductor ASA
 *
 * SPDX-License-Identifier: LicenseRef-Nordic-5-Clause
 *
 * Modifié : client à un seul bouton et deux LEDs
 *  - pas encore appairé : appui  -> provisioning
 *  - appairé, simple clic        -> commande selon le mode
 *        mode 1 (SERVER) : PUT /light  -> LED du serveur
 *        mode 2 (RELAY)  : PUT /relay  -> LED de l'autre client via le serveur
 *  - appairé, double clic        -> changement de mode
 *
 *  LED rouge (STATUS_LED) : éteinte = pas connecté Thread
 *                           fixe    = connecté, mode 1
 *                           clignote= connecté, mode 2
 *  LED bleue (LIGHT_LED)  : lumière de ce client (pilotée par l'autre client)
 */

#include <zephyr/kernel.h>
#include <dk_buttons_and_leds.h>
#include <zephyr/logging/log.h>
#include <ram_pwrdn.h>
#include <zephyr/device.h>
#include <zephyr/pm/device.h>

#include "coap_client_utils.h"
#include <coap_server_client_interface.h>

#if CONFIG_BT_NUS
#include "ble_utils.h"
#endif

LOG_MODULE_REGISTER(coap_client, CONFIG_COAP_CLIENT_LOG_LEVEL);

/* Vérifiez sur votre carte laquelle est rouge et laquelle est bleue,
 * et inversez DK_LED1 / DK_LED2 si besoin. */
#define STATUS_LED DK_LED1        /* rouge */
#define LIGHT_LED  DK_LED2        /* bleue */

#define USER_BUTTON_MSK DK_BTN1_MSK
#define DOUBLE_CLICK_MS 400       /* délai max entre deux appuis */
#define MODE2_BLINK_MS  500       /* clignotement de la LED rouge en mode 2 */

enum client_mode {
	MODE_SERVER = 0,   /* mode 1 : contrôle la LED du serveur      */
	MODE_RELAY  = 1,   /* mode 2 : contrôle l'autre client (relay) */
};

static volatile enum client_mode mode = MODE_SERVER;
static volatile bool ot_connected;

/* ------------------------------------------------------------------ */
/* LED rouge : état connexion + mode                                   */
/* ------------------------------------------------------------------ */

static void on_status_blink(struct k_timer *timer)
{
	static uint8_t on;

	ARG_UNUSED(timer);

	on = !on;
	dk_set_led(STATUS_LED, on);
}

K_TIMER_DEFINE(status_blink_timer, on_status_blink, NULL);

static void update_status_led(void)
{
	if (!ot_connected) {
		k_timer_stop(&status_blink_timer);
		dk_set_led_off(STATUS_LED);
	} else if (mode == MODE_SERVER) {
		k_timer_stop(&status_blink_timer);
		dk_set_led_on(STATUS_LED);
	} else {
		k_timer_start(&status_blink_timer, K_NO_WAIT,
			      K_MSEC(MODE2_BLINK_MS));
	}
}

/* ------------------------------------------------------------------ */
/* Détection simple / double clic                                      */
/* ------------------------------------------------------------------ */


static void on_light_cmd(uint8_t cmd)
{
	static uint8_t val;

	switch (cmd) {
	case THREAD_COAP_UTILS_LIGHT_CMD_ON:     val = 1;    break;
	case THREAD_COAP_UTILS_LIGHT_CMD_OFF:    val = 0;    break;
	case THREAD_COAP_UTILS_LIGHT_CMD_TOGGLE: val = !val; break;
	default: return;
	}

	dk_set_led(LIGHT_LED, val);
}


/* Appelé quand aucun second appui n'est arrivé : c'était un simple clic */
static void on_click_timer_expiry(struct k_timer *timer)
{
	ARG_UNUSED(timer);

	if (mode == MODE_SERVER) {
		LOG_INF("Single click -> toggle server light");
		coap_client_toggle_one_light();
	} else {
		LOG_INF("Single click -> relay toggle to other client");
		coap_client_relay_toggle();
	}
}

K_TIMER_DEFINE(click_timer, on_click_timer_expiry, NULL);

static void switch_mode(void)
{
	mode = (mode == MODE_SERVER) ? MODE_RELAY : MODE_SERVER;

	LOG_INF("Double click -> mode %s",
		mode == MODE_SERVER ? "1 (SERVER)" : "2 (RELAY)");
	update_status_led();
}

#if CONFIG_BT_NUS

#define COMMAND_REQUEST_UNICAST 'u'
#define COMMAND_REQUEST_MULTICAST 'm'
#define COMMAND_REQUEST_PROVISIONING 'p'
#define COMMAND_REQUEST_RELAY 'r'

static void on_nus_received(struct bt_conn *conn, const uint8_t *const data, uint16_t len)
{
	LOG_INF("Received data: %c", data[0]);

	switch (*data) {
	case COMMAND_REQUEST_UNICAST:
		coap_client_toggle_one_light();
		break;

	case COMMAND_REQUEST_MULTICAST:
		coap_client_toggle_mesh_lights();
		break;

	case COMMAND_REQUEST_PROVISIONING:
		coap_client_send_provisioning_request();
		break;

	case COMMAND_REQUEST_RELAY:
		coap_client_relay_toggle();
		break;

	default:
		LOG_WRN("Received invalid data from NUS");
	}
}

/* Plus de LED dédiée au BLE : on se contente d'un log */
static void on_ble_connect(struct k_work *item)
{
	ARG_UNUSED(item);
	LOG_INF("BLE connected");
}

static void on_ble_disconnect(struct k_work *item)
{
	ARG_UNUSED(item);
	LOG_INF("BLE disconnected");
}

#endif /* CONFIG_BT_NUS */

static void on_ot_connect(struct k_work *item)
{
	ARG_UNUSED(item);

	ot_connected = true;
	update_status_led();
}

static void on_ot_disconnect(struct k_work *item)
{
	ARG_UNUSED(item);

	ot_connected = false;
	
	update_status_led();
}

static void on_mtd_mode_toggle(uint32_t med)
{
#if IS_ENABLED(CONFIG_PM_DEVICE)
	const struct device *cons = DEVICE_DT_GET(DT_CHOSEN(zephyr_console));

	if (!device_is_ready(cons)) {
		return;
	}

	if (med) {
		pm_device_action_run(cons, PM_DEVICE_ACTION_RESUME);
	} else {
		pm_device_action_run(cons, PM_DEVICE_ACTION_SUSPEND);
	}
#endif
	/* Plus de LED pour le mode SED/MED (seulement 2 LEDs) */
	LOG_INF("MTD mode: %s", med ? "MED" : "SED");
}

static void on_button_changed(uint32_t button_state, uint32_t has_changed)
{
	uint32_t pressed = button_state & has_changed;

	if (!(pressed & USER_BUTTON_MSK)) {
		return;
	}

	/* Pas encore d'adresse serveur : chaque appui lance le provisioning */
	if (!coap_client_is_provisioned()) {
		LOG_INF("Not provisioned -> send provisioning request");
		coap_client_send_provisioning_request();
		return;
	}

	if (k_timer_remaining_get(&click_timer) > 0) {
	
		k_timer_stop(&click_timer);
		switch_mode();
	} else {
	
		k_timer_start(&click_timer, K_MSEC(DOUBLE_CLICK_MS), K_NO_WAIT);
	}
}

int main(void)
{
	int ret;

	LOG_INF("Start CoAP-client sample");

	if (IS_ENABLED(CONFIG_RAM_POWER_DOWN_LIBRARY)) {
		power_down_unused_ram();
	}

	ret = dk_buttons_init(on_button_changed);
	if (ret) {
		LOG_ERR("Cannot init buttons (error: %d)", ret);
		return 0;
	}

	ret = dk_leds_init();
	if (ret) {
		LOG_ERR("Cannot init leds, (error: %d)", ret);
		return 0;
	}

	dk_set_led_off(STATUS_LED);
	dk_set_led_off(LIGHT_LED);

#if CONFIG_BT_NUS
	struct bt_nus_cb nus_clbs = {
		.received = on_nus_received,
		.sent = NULL,
	};

	ret = ble_utils_init(&nus_clbs, on_ble_connect, on_ble_disconnect);
	if (ret) {
		LOG_ERR("Cannot init BLE utilities");
		return 0;
	}

#endif /* CONFIG_BT_NUS */
	coap_client_set_light_cmd_handler(on_light_cmd);
	coap_client_utils_init(on_ot_connect, on_ot_disconnect, on_mtd_mode_toggle);

	return 0;
}
```

## src/coap_client_utils.c
```c
/*
 * Copyright (c) 2020 Nordic Semiconductor ASA
 *
 * SPDX-License-Identifier: LicenseRef-Nordic-5-Clause
 */

#include <zephyr/kernel.h>
#include <coap_server_client_interface.h>
#include <net/coap_utils.h>
#include <zephyr/logging/log.h>
#include <zephyr/net/socket.h>
#include <openthread.h>
#include <openthread/thread.h>
#include <openthread/coap.h>
#include <openthread/message.h>

#include "coap_client_utils.h"
static const char *const relay_option[] = { RELAY_URI_PATH, NULL };
static struct k_work relay_work;

LOG_MODULE_REGISTER(coap_client_utils, CONFIG_COAP_CLIENT_UTILS_LOG_LEVEL);


static light_cmd_cb_t on_light_cmd;

static void light_request_handler(void *context, otMessage *message,
				  const otMessageInfo *message_info)
{
	uint8_t command;

	ARG_UNUSED(context);
	ARG_UNUSED(message_info);

	if (otCoapMessageGetCode(message) != OT_COAP_CODE_PUT) {
		return;
	}

	if (otMessageRead(message, otMessageGetOffset(message), &command, 1) != 1) {
		return;
	}

	LOG_INF("Received light command from server: %c", command);

	if (on_light_cmd) {
		on_light_cmd(command);
	}
}

static otCoapResource light_resource = {
	.mUriPath = LIGHT_URI_PATH,
	.mHandler = light_request_handler,
	.mContext = NULL,
	.mNext = NULL,
};

static void light_resource_start(void)
{
	otError error;
	otInstance *instance = openthread_get_default_instance();

	openthread_mutex_lock();
	otCoapAddResource(instance, &light_resource);
	error = otCoapStart(instance, COAP_PORT);
	openthread_mutex_unlock();

	if (error != OT_ERROR_NONE) {
		LOG_ERR("Failed to start OT CoAP on client (err %d)", error);
	}
}

#define RESPONSE_POLL_PERIOD 100

static uint32_t poll_period;

static bool is_connected;

#define COAP_CLIENT_WORKQ_STACK_SIZE 2048
#define COAP_CLIENT_WORKQ_PRIORITY 5

K_THREAD_STACK_DEFINE(coap_client_workq_stack_area, COAP_CLIENT_WORKQ_STACK_SIZE);
static struct k_work_q coap_client_workq;

static struct k_work unicast_light_work;
static struct k_work multicast_light_work;
static struct k_work toggle_MTD_SED_work;
static struct k_work provisioning_work;
static struct k_work on_connect_work;
static struct k_work on_disconnect_work;

mtd_mode_toggle_cb_t on_mtd_mode_toggle;

/* Options supported by the server */
static const char *const light_option[] = { LIGHT_URI_PATH, NULL };
static const char *const provisioning_option[] = { PROVISIONING_URI_PATH,
						   NULL };

/* Thread multicast mesh local address */
static struct sockaddr_in6 multicast_local_addr = {
	.sin6_family = AF_INET6,
	.sin6_port = htons(COAP_PORT),
	.sin6_addr.s6_addr = { 0xff, 0x03, 0x00, 0x00, 0x00, 0x00, 0x00, 0x00,
			       0x00, 0x00, 0x00, 0x00, 0x00, 0x00, 0x00, 0x01 },
	.sin6_scope_id = 0U
};

/* Variable for storing server address acquiring in provisioning handshake */
static char unique_local_addr_str[INET6_ADDRSTRLEN];
static struct sockaddr_in6 unique_local_addr = {
	.sin6_family = AF_INET6,
	.sin6_port = htons(COAP_PORT),
	.sin6_addr.s6_addr = {0, },
	.sin6_scope_id = 0U
};

static bool is_mtd_in_med_mode(otInstance *instance)
{
	return otThreadGetLinkMode(instance).mRxOnWhenIdle;
}

static void relay_toggle(struct k_work *item)
{
	uint8_t payload = (uint8_t)THREAD_COAP_UTILS_LIGHT_CMD_TOGGLE;

	ARG_UNUSED(item);

	if (!coap_client_is_provisioned()) {
		LOG_WRN("Peer address not set");
		return;
	}

	LOG_INF("Send 'relay' request to: %s", unique_local_addr_str);
	coap_send_request(COAP_METHOD_PUT,
			  (const struct sockaddr *)&unique_local_addr,
			  relay_option, &payload, sizeof(payload), NULL);
}

static void poll_period_response_set(void)
{
	otError error;

	otInstance *instance = openthread_get_default_instance();

	if (is_mtd_in_med_mode(instance)) {
		return;
	}

	if (!poll_period) {
		poll_period = otLinkGetPollPeriod(instance);

		error = otLinkSetPollPeriod(instance, RESPONSE_POLL_PERIOD);
		__ASSERT(error == OT_ERROR_NONE, "Failed to set pool period");

		LOG_INF("Poll Period: %dms set", RESPONSE_POLL_PERIOD);
	}
}

static void poll_period_restore(void)
{
	otError error;
	otInstance *instance = openthread_get_default_instance();

	if (is_mtd_in_med_mode(instance)) {
		return;
	}

	if (poll_period) {
		error = otLinkSetPollPeriod(instance, poll_period);
		__ASSERT_NO_MSG(error == OT_ERROR_NONE);

		LOG_INF("Poll Period: %dms restored", poll_period);
		poll_period = 0;
	}
}

static int on_provisioning_reply(const struct coap_packet *response,
				 struct coap_reply *reply,
				 const struct sockaddr *from)
{
	int ret = 0;
	const uint8_t *payload;
	uint16_t payload_size = 0u;

	ARG_UNUSED(reply);
	ARG_UNUSED(from);

	payload = coap_packet_get_payload(response, &payload_size);

	if (payload == NULL ||
	    payload_size != sizeof(unique_local_addr.sin6_addr)) {
		LOG_ERR("Received data is invalid");
		ret = -EINVAL;
		goto exit;
	}

	memcpy(&unique_local_addr.sin6_addr, payload, payload_size);

	if (!zsock_inet_ntop(AF_INET6, payload, unique_local_addr_str,
		       INET6_ADDRSTRLEN)) {
		LOG_ERR("Received data is not IPv6 address: %d", errno);
		ret = -errno;
		goto exit;
	}

	LOG_INF("Received peer address: %s", unique_local_addr_str);

exit:
	if (IS_ENABLED(CONFIG_OPENTHREAD_MTD_SED)) {
		poll_period_restore();
	}

	return ret;
}

static void toggle_one_light(struct k_work *item)
{
	uint8_t payload = (uint8_t)THREAD_COAP_UTILS_LIGHT_CMD_TOGGLE;

	ARG_UNUSED(item);

	if (unique_local_addr.sin6_addr.s6_addr16[0] == 0) {
		LOG_WRN("Peer address not set. Activate 'provisioning' option "
			"on the server side");
		return;
	}

	LOG_INF("Send 'light' request to: %s", unique_local_addr_str);
	coap_send_request(COAP_METHOD_PUT,
			  (const struct sockaddr *)&unique_local_addr,
			  light_option, &payload, sizeof(payload), NULL);
}

static void toggle_mesh_lights(struct k_work *item)
{
	static uint8_t command = (uint8_t)THREAD_COAP_UTILS_LIGHT_CMD_OFF;

	ARG_UNUSED(item);

	command = ((command == THREAD_COAP_UTILS_LIGHT_CMD_OFF) ?
			   THREAD_COAP_UTILS_LIGHT_CMD_ON :
			   THREAD_COAP_UTILS_LIGHT_CMD_OFF);

	LOG_INF("Send multicast mesh 'light' request");
	coap_send_request(COAP_METHOD_PUT,
			  (const struct sockaddr *)&multicast_local_addr,
			  light_option, &command, sizeof(command), NULL);
}

static void send_provisioning_request(struct k_work *item)
{
	ARG_UNUSED(item);

	if (IS_ENABLED(CONFIG_OPENTHREAD_MTD_SED)) {
		/* decrease the polling period for higher responsiveness */
		poll_period_response_set();
	}

	LOG_INF("Send 'provisioning' request");
	coap_send_request(COAP_METHOD_GET,
			  (const struct sockaddr *)&multicast_local_addr,
			  provisioning_option, NULL, 0u, on_provisioning_reply);
}

static void toggle_minimal_sleepy_end_device(struct k_work *item)
{
	otError error;
	otLinkModeConfig mode;
	struct otInstance *instance = openthread_get_default_instance();

	openthread_mutex_lock();
	mode = otThreadGetLinkMode(instance);
	mode.mRxOnWhenIdle = !mode.mRxOnWhenIdle;
	error = otThreadSetLinkMode(instance, mode);
	openthread_mutex_unlock();

	if (error != OT_ERROR_NONE) {
		LOG_ERR("Failed to set MLE link mode configuration");
	} else {
		on_mtd_mode_toggle(mode.mRxOnWhenIdle);
	}
}

static void update_device_state(void)
{
	struct otInstance *instance = openthread_get_default_instance();
	otLinkModeConfig mode = otThreadGetLinkMode(instance);
	on_mtd_mode_toggle(mode.mRxOnWhenIdle);
}

static void on_thread_state_changed(otChangedFlags flags, void *user_data)
{
	struct otInstance *instance = openthread_get_default_instance();

	if (flags & OT_CHANGED_THREAD_ROLE) {
		switch (otThreadGetDeviceRole(instance)) {
		case OT_DEVICE_ROLE_CHILD:
		case OT_DEVICE_ROLE_ROUTER:
		case OT_DEVICE_ROLE_LEADER:
			k_work_submit_to_queue(&coap_client_workq, &on_connect_work);
			is_connected = true;
			break;

		case OT_DEVICE_ROLE_DISABLED:
		case OT_DEVICE_ROLE_DETACHED:
		default:
			k_work_submit_to_queue(&coap_client_workq, &on_disconnect_work);
			is_connected = false;
			break;
		}
	}
}
static struct openthread_state_changed_callback ot_state_chaged_cb = {
	.otCallback = on_thread_state_changed};

static void submit_work_if_connected(struct k_work *work)
{
	if (is_connected) {
		k_work_submit_to_queue(&coap_client_workq, work);
	} else {
		LOG_INF("Connection is broken");
	}
}

void coap_client_utils_init(ot_connection_cb_t on_connect,
			    ot_disconnection_cb_t on_disconnect,
			    mtd_mode_toggle_cb_t on_toggle)
{
	on_mtd_mode_toggle = on_toggle;

	coap_init(AF_INET6, NULL);


	k_work_queue_init(&coap_client_workq);

	k_work_queue_start(&coap_client_workq, coap_client_workq_stack_area,
					K_THREAD_STACK_SIZEOF(coap_client_workq_stack_area),
					COAP_CLIENT_WORKQ_PRIORITY, NULL);

	k_work_init(&on_connect_work, on_connect);
	k_work_init(&on_disconnect_work, on_disconnect);
	k_work_init(&unicast_light_work, toggle_one_light);
	k_work_init(&multicast_light_work, toggle_mesh_lights);
	k_work_init(&provisioning_work, send_provisioning_request);
	k_work_init(&relay_work, relay_toggle);
	light_resource_start();

	openthread_state_changed_callback_register(&ot_state_chaged_cb);
	openthread_run();

	if (IS_ENABLED(CONFIG_OPENTHREAD_MTD_SED)) {
		k_work_init(&toggle_MTD_SED_work,
			    toggle_minimal_sleepy_end_device);
		update_device_state();
	}
}

void coap_client_toggle_one_light(void)
{
	submit_work_if_connected(&unicast_light_work);
}

void coap_client_toggle_mesh_lights(void)
{
	submit_work_if_connected(&multicast_light_work);
}

void coap_client_send_provisioning_request(void)
{
	submit_work_if_connected(&provisioning_work);
}

void coap_client_toggle_minimal_sleepy_end_device(void)
{
	if (IS_ENABLED(CONFIG_OPENTHREAD_MTD_SED)) {
		k_work_submit_to_queue(&coap_client_workq, &toggle_MTD_SED_work);
	}
}

bool coap_client_is_provisioned(void)
{
	return unique_local_addr.sin6_addr.s6_addr16[0] != 0;
}

void coap_client_relay_toggle(void)
{
	submit_work_if_connected(&relay_work);
}
void coap_client_set_light_cmd_handler(light_cmd_cb_t cb)
{
	on_light_cmd = cb;
}
```

## src/coap_client_utils.h
```c
/**
 * @file
 * @defgroup coap_client_utils API for coap_client_* samples
 * @{
 */

/*
 * Copyright (c) 2020 Nordic Semiconductor ASA
 *
 * SPDX-License-Identifier: LicenseRef-Nordic-5-Clause
 */

#ifndef __COAP_CLIENT_UTILS_H__
#define __COAP_CLIENT_UTILS_H__

#include <stdbool.h>


/** @brief Type indicates function called when OpenThread connection
 *         is established.
 *
 * @param[in] item pointer to work item.
 */
typedef void (*ot_connection_cb_t)(struct k_work *item);

/** @brief Type indicates function called when OpenThread connection is ended.
 *
 * @param[in] item pointer to work item.
 */
typedef void (*ot_disconnection_cb_t)(struct k_work *item);

/** @brief Type indicates function called when the MTD modes are toggled.
 *
 * @param[in] val 1 if the MTD is in MED mode
 *                0 if the MTD is in SED mode
 */
typedef void (*mtd_mode_toggle_cb_t)(uint32_t val);

/** @brief Initialize CoAP client utilities.
 */
void coap_client_utils_init(ot_connection_cb_t on_connect,
			    ot_disconnection_cb_t on_disconnect,
			    mtd_mode_toggle_cb_t on_toggle);

/** @brief Toggle light on the CoAP server node.
 *
 * @note The CoAP server should be paired before to have an affect.
 */
void coap_client_toggle_one_light(void);

/** @brief Toggle lights on all CoAP servers in the network mesh.
 */
void coap_client_toggle_mesh_lights(void);

/** @brief Request for the CoAP server address to pair.
 *
 * @note Enable paring on the CoAP server to get the address.
 */
void coap_client_send_provisioning_request(void);

/** @brief Toggle SED to MED and MED to SED modes.
 *
 * @note Active when the device is working as Minimal Thread Device.
 */
void coap_client_toggle_minimal_sleepy_end_device(void);
bool coap_client_is_provisioned(void);
void coap_client_relay_toggle(void);
typedef void (*light_cmd_cb_t)(uint8_t cmd);
void coap_client_set_light_cmd_handler(light_cmd_cb_t cb);



#endif

/**
 * @}
 */
```
